## Documentation/devicetree/bindings/gpu/nintendo,flipper-gx.yaml
```yaml
# SPDX-License-Identifier: (GPL-2.0-only OR BSD-2-Clause)
%YAML 1.2
---
$id: http://devicetree.org/schemas/gpu/nintendo,flipper-gx.yaml#
$schema: http://devicetree.org/meta-schemas/core.yaml#

title: Nintendo Flipper and Hollywood GX graphics processor

maintainers:
  - Bill Carson <anolisporcatus@gmail.com>

description: |
  GX is the fixed-function graphics processor in the Nintendo GameCube
  Flipper and Wii Hollywood chipsets.  Its command processor and pixel engine
  have separate register windows.  Command and texture storage must reside in
  the console's MEM1 memory, while FIFO pointer registers are shared with the
  processor interface interrupt controller.

properties:
  $nodename:
    pattern: '^gpu@[a-f0-9]+$'

  compatible:
    oneOf:
      - items:
          - const: nintendo,hollywood-gx
          - const: nintendo,flipper-gx
      - const: nintendo,flipper-gx

  reg:
    minItems: 2
    maxItems: 2

  reg-names:
    items:
      - const: cp
      - const: pe

  interrupts:
    maxItems: 1
    description: Pixel-engine token and finish interrupt.

  memory-region:
    minItems: 2
    maxItems: 2
    description:
      Reserved MEM1 regions used for the command FIFO and bounded texture
      workspace allocator.

  memory-region-names:
    items:
      - const: fifo
      - const: texture

  nintendo,processor-interface:
    $ref: /schemas/types.yaml#/definitions/phandle
    description:
      Processor-interface syscon containing the shared GX FIFO pointers.

required:
  - compatible
  - reg
  - reg-names
  - interrupts
  - memory-region
  - memory-region-names
  - nintendo,processor-interface

additionalProperties: false

examples:
  - |
    gpu@c000000 {
        compatible = "nintendo,hollywood-gx", "nintendo,flipper-gx";
        reg = <0x0c000000 0x80>, <0x0c001000 0x10>;
        reg-names = "cp", "pe";
        interrupts = <10>;
        memory-region = <&gx_fifo>, <&gx_texture>;
        memory-region-names = "fifo", "texture";
        nintendo,processor-interface = <&pi>;
    };
...
```

## Documentation/devicetree/bindings/i2c/nintendo,wii-ave-i2c.yaml
```yaml
# SPDX-License-Identifier: (GPL-2.0-only OR BSD-2-Clause)
%YAML 1.2
---
$id: http://devicetree.org/schemas/i2c/nintendo,wii-ave-i2c.yaml#
$schema: http://devicetree.org/meta-schemas/core.yaml#

title: Nintendo Wii audio/video encoder GPIO I2C controller

maintainers:
  - Bill Carson <anolisporcatus@gmail.com>

description: |
  The Nintendo Wii connects the Hollywood chipset to its audio/video encoder
  through a GPIO-backed I2C bus. SCL must remain an actively driven output,
  while SDA changes to input only when the master reads acknowledgements or
  data. The generic i2c-gpio open-drain emulation does not provide these line
  direction semantics.

allOf:
  - $ref: /schemas/i2c/i2c-controller.yaml#

properties:
  compatible:
    const: nintendo,wii-ave-i2c

  sda-gpios:
    description: Hollywood GPIO connected to the encoder data line
    maxItems: 1

  scl-gpios:
    description: Hollywood GPIO connected to the encoder clock line
    maxItems: 1

required:
  - compatible
  - sda-gpios
  - scl-gpios

unevaluatedProperties: false

...
```

## drivers/gpu/drm/gcn/Kconfig
```kconfig
# SPDX-License-Identifier: GPL-2.0-only

config DRM_GCN
	bool

config DRM_GCN_VI
	tristate "Nintendo GameCube/Wii Video Interface KMS"
	depends on DRM && WII && I2C
	select DRM_GCN
	select DRM_CLIENT_SELECTION
	select DRM_GEM_SHMEM_HELPER
	select DRM_KMS_HELPER
	help
	  Build an atomic DRM/KMS driver for the Nintendo GameCube/Wii Video
	  Interface. The initial driver converts RGB scanout buffers into the
	  packed YUYV external framebuffer consumed by the VI.

	  The legacy FB_GAMECUBE driver and this driver may be compiled
	  together for migration testing, but only one can bind the VI device
	  at a time. Production configurations should select one display
	  driver.

	  If M is selected, the module will be called gcn-drm.

config DRM_GCN_GX
	tristate "Nintendo GameCube/Wii GX scanout accelerator"
	depends on DRM_GCN_VI && WII
	depends on !FB_GAMECUBE_GX
	select MFD_SYSCON
	help
	  Build the GX fixed-function renderer as an optional scanout backend for
	  the GCN VI DRM driver. GX converts RGB565 shadow buffers into inactive
	  YUYV XFB pages while DRM retains VI, vblank, and page-flip ownership.
	  Internal GX-visible work buffers are allocated from the bounded MEM1
	  texture region described by the device tree.

	  Removing or failing this module leaves the DRM driver's CPU conversion
	  path active. If M is selected, the module will be called gcn-gx.

config DRM_GCN_XFB_OBSERVER
	tristate "Nintendo GameCube/Wii XFB debug observer"
	depends on WII
	help
	  Build a read-only diagnostic module that samples the XFB page currently
	  selected by the Wii Video Interface. This is intended for development
	  and should normally be left disabled.

	  If M is selected, the module will be called gcn-xfb-observer.

config DRM_GCN_GX_MEM1_KUNIT_TEST
	tristate "KUnit tests for Nintendo GX MEM1 allocation" if !KUNIT_ALL_TESTS
	depends on KUNIT && DRM
	select DRM_GCN
	default KUNIT_ALL_TESTS
	help
	  Test the bounded range, alignment, deterministic placement, exhaustion,
	  freeing, and reuse behavior used by the GX MEM1 workspace allocator.
	  These tests run without Nintendo hardware and do not load the GX driver.
	  This option is intended only for kernel developers working on GX memory
	  management and should normally be left disabled.
```
